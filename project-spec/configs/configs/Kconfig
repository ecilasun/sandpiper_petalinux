## project-spec/configs/configs/Kconfig
```kconfig
mainmenu "PetaLinux System Configuration"
config SUBSYSTEM_TYPE_LINUX
        bool
        default y
        select SYSTEM_ZYNQ

config SYSTEM_ZYNQ
        bool "ZYNQ Configuration"
        help
          ZYNQ Configuration for the project.
          All these config options will be in /home/ecilasun/sandpiper_petalinux/project-spec/configs/config

config SUBSYSTEM_DISTRO_PETALINUX
        bool
        default y
        help

source /home/ecilasun/sandpiper_petalinux/project-spec/configs/configs/Kconfig.main
```

## project-spec/configs/rootfsconfigs/Kconfig.user
```kconfig
menu "user packages " 
config gpio-demo  
	 bool "gpio-demo"
	 help
	
config peekpoke  
	 bool "peekpoke"
	 help
	
config sandpiper  
	 bool "sandpiper"
	 help
	
endmenu
```
